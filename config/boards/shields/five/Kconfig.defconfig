## config/boards/shields/five/Kconfig.defconfig
```kconfig
# Copyright (c) 2020 The ZMK Contributors
# SPDX-License-Identifier: MIT

if SHIELD_FIVE_LEFT

config ZMK_KEYBOARD_NAME
	default "Number Five"

config ZMK_SPLIT_BLE_ROLE_CENTRAL
	default y

endif

if SHIELD_FIVE_LEFT || SHIELD_FIVE_RIGHT

config ZMK_SPLIT
	default y

endif
```

## config/boards/shields/five/Kconfig.shield
```kconfig
# Copyright (c) 2020 The ZMK Contributors
# SPDX-License-Identifier: MIT

config SHIELD_FIVE_LEFT
	def_bool $(shields_list_contains,five_left)

config SHIELD_FIVE_RIGHT
	def_bool $(shields_list_contains,five_right)
```

## config/boards/shields/seven/Kconfig.defconfig
```kconfig
# Copyright (c) 2020 The ZMK Contributors
# SPDX-License-Identifier: MIT

if SHIELD_SEVEN_LEFT

config ZMK_KEYBOARD_NAME
	default "Number Seven"

config ZMK_SPLIT_BLE_ROLE_CENTRAL
	default y

endif

if SHIELD_SEVEN_LEFT || SHIELD_SEVEN_RIGHT

config ZMK_SPLIT
	default y

endif
```

## config/boards/shields/seven/Kconfig.shield
```kconfig
# Copyright (c) 2020 The ZMK Contributors
# SPDX-License-Identifier: MIT

config SHIELD_SEVEN_LEFT
	def_bool $(shields_list_contains,seven_left)

config SHIELD_SEVEN_RIGHT
	def_bool $(shields_list_contains,seven_right)
```
